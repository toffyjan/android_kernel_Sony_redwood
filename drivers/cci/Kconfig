## drivers/cci/Kconfig
```kconfig
#
# Compalcomm drivers
#

menuconfig CCI_DRIVERS
        tristate "Compalcomm drivers for LY28."
        default y

if CCI_DRIVERS

#[LY28] ==> CCI KLog, added by Jimmy@CCI
source "drivers/cci/klog/Kconfig"
#[LY28] <== CCI KLog, added by Jimmy@CCI

endif
```

## drivers/cci/klog/Kconfig
```kconfig
config CCI_KLOG
	bool "CCI KLog <?>"
	default n
	help
	  ****** NOTE: configuration overwrite order: BoardConfig/ProjectConfig > Kconfig ******
	  ****** If you have BoardConfig/ProjectConfig, please DO NOT change this configuration here ******
	  CCI kernel and logcat log collector.

config CCI_KLOG_RECORD_KERNEL_TIMESTAMP
	bool "Record kernel timestmp into KLog header area"
	depends on CCI_KLOG
	default y
	help
	  This option enables KLog to record the kernel timestamp into the CCI KLog header area.

config CCI_KLOG_RECORD_RPM_VERSION
	bool "Record the RPM firmware version into KLog header area"
	depends on CCI_KLOG
	default n
	help
	  This option enables KLog to record the RPM firmware version into the CCI KLog header area.
          This may only be useful in DA80, DA80_ICS and SA77 projects.

config CCI_KLOG_START_ADDR_PHYSICAL
	hex "Physical memory start address <?>"
	depends on CCI_KLOG
	help
	  ****** NOTE: configuration overwrite order: BoardConfig/ProjectConfig > Kconfig ******
	  ****** If you have BoardConfig/ProjectConfig, please DO NOT change this configuration here ******
	  The start address of KLog buffer on physical memory.

config CCI_KLOG_SIZE
	hex "Total buffer size <?>"
	depends on CCI_KLOG
	help
	  ****** NOTE: configuration overwrite order: BoardConfig/ProjectConfig > Kconfig ******
	  ****** If you have BoardConfig/ProjectConfig, please DO NOT change this configuration here ******
	  The total buffer size of CCI KLog.

config CCI_KLOG_HEADER_SIZE
	hex "Header size <?>"
	depends on CCI_KLOG
	help
	  ****** NOTE: configuration overwrite order: BoardConfig/ProjectConfig > Kconfig ******
	  ****** If you have BoardConfig/ProjectConfig, please DO NOT change this configuration here ******
	  The header buffer size of CCI KLog.

config CCI_KLOG_CRASH_SIZE
	hex "Crash size <?>"
	depends on CCI_KLOG
	help
	  ****** NOTE: configuration overwrite order: BoardConfig/ProjectConfig > Kconfig ******
	  ****** If you have BoardConfig/ProjectConfig, please DO NOT change this configuration here ******
	  The crash buffer size of CCI KLog.

config CCI_KLOG_APPSBL_SIZE
	hex "AppSBL size <?>"
	depends on CCI_KLOG
	help
	  ****** NOTE: configuration overwrite order: BoardConfig/ProjectConfig > Kconfig ******
	  ****** If you have BoardConfig/ProjectConfig, please DO NOT change this configuration here ******
	  The AppSBL size of CCI KLog.

config CCI_KLOG_KERNEL_SIZE
	hex "Kernel size <?>"
	depends on CCI_KLOG
	help
	  ****** NOTE: configuration overwrite order: BoardConfig/ProjectConfig > Kconfig ******
	  ****** If you have BoardConfig/ProjectConfig, please DO NOT change this configuration here ******
	  The kernel buffer size of CCI KLog.

config CCI_KLOG_ANDROID_MAIN_SIZE
	hex "Android main size <?>"
	depends on CCI_KLOG
	help
	  ****** NOTE: configuration overwrite order: BoardConfig/ProjectConfig > Kconfig ******
	  ****** If you have BoardConfig/ProjectConfig, please DO NOT change this configuration here ******
	  The Android main buffer size of CCI KLog.

config CCI_KLOG_ANDROID_SYSTEM_SIZE
	hex "Android system size <?>"
	depends on CCI_KLOG
	help
	  ****** NOTE: configuration overwrite order: BoardConfig/ProjectConfig > Kconfig ******
	  ****** If you have BoardConfig/ProjectConfig, please DO NOT change this configuration here ******
	  The Android system buffer size of CCI KLog.

config CCI_KLOG_ANDROID_RADIO_SIZE
	hex "Android radio size <?>"
	depends on CCI_KLOG
	help
	  ****** NOTE: configuration overwrite order: BoardConfig/ProjectConfig > Kconfig ******
	  ****** If you have BoardConfig/ProjectConfig, please DO NOT change this configuration here ******
	  The Android radio buffer size of CCI KLog.

config CCI_KLOG_ANDROID_EVENTS_SIZE
	hex "Android events size <?>"
	depends on CCI_KLOG
	help
	  ****** NOTE: configuration overwrite order: BoardConfig/ProjectConfig > Kconfig ******
	  ****** If you have BoardConfig/ProjectConfig, please DO NOT change this configuration here ******
	  The Android events buffer size of CCI KLog.

config CCI_KLOG_ALLOW_FORCE_PANIC
	bool "Allow force panic function <?>"
	depends on CCI_KLOG
	default n
	help
	  ****** NOTE: configuration overwrite order: BoardConfig/ProjectConfig > Kconfig ******
	  ****** If you have BoardConfig/ProjectConfig, please DO NOT change this configuration here ******
	  Allows the force panic function.
	  This function should be disabled in user-variant or shipping build.

config CCI_KLOG_SUPPORT_CCI_ENGMODE
	bool "Support CCI EngMode function <?>"
	depends on CCI_KLOG
	default n
	help
	  ****** NOTE: configuration overwrite order: BoardConfig/ProjectConfig > Kconfig ******
	  ****** If you have BoardConfig/ProjectConfig, please DO NOT change this configuration here ******
	  Supports CCI EngMode function.
	  This may only be useful in DA80_ICS project.

config CCI_KLOG_SUPPORT_RESTORATION
	bool "Support restoration function <?>"
	depends on CCI_KLOG
	default n
	help
	  ****** NOTE: configuration overwrite order: BoardConfig/ProjectConfig > Kconfig ******
	  ****** If you have BoardConfig/ProjectConfig, please DO NOT change this configuration here ******
	  Supports the restoration function.
	  This may only be useful in VY5x project.
```

## drivers/input/fpc/Kconfig
```kconfig
#
# FPC sensors
#

config INPUT_FPC1020_IRQ
	tristate "FPC1020 fingerprint sensor IRQ support"
	help
		If you say yes here you get IRQ support for the FPC1020 family
		of fingerprint sensors from Fingerprint Cards (FPC).
```

## drivers/input/touchscreen/mediatek/Kconfig
```kconfig
#
# Touchscreen driver configuration
#
menuconfig INPUT_TOUCHSCREEN
	bool "Touchscreens"
	help
	  Say Y here, and a list of supported touchscreens will be displayed.
	  This option doesn't affect the kernel.

	  If unsure, say Y.

if INPUT_TOUCHSCREEN

config TOUCHSCREEN_MTK
	bool "MediaTek Touch Panel Driver"
	help
	  Say Y here if you have MediaTek touch panel.

	  If unsure, say N.

	  To compile this dirver as a module, choose M here: the
	  module will be called.

config TOUCHSCREEN_MTK_GT1151
	bool "GT1151 for Mediatek package"
	default n
	help
	  Say Y here if you have GT1151 touch panel.

	  If unsure, say N.

	  To compile this dirver as a module, choose M here: the
	  module will be called.

source "drivers/input/touchscreen/mediatek/GT1151/Kconfig"

config TOUCHSCREEN_MTK_FT8607
	bool "FT8607 for Mediatek package"
	default n
	help
	  Say Y here if you have FT8607 touch panel.

	  If unsure, say N.

	  To compile this dirver as a module, choose M here: the
	  module will be called.

source "drivers/input/touchscreen/mediatek/ft8607/Kconfig"

config TOUCHSCREEN_MTK_SYNAPTICS_TD4322
	bool "Synaptics TD4322 dfor Mediatek package"
	default n
	help
	  Say Y here if you have TD4322 touch panel.

	  If unsure, say N.

	  To compile this driver as a module, choose M here: the
	  module will be called.

source "drivers/input/touchscreen/mediatek/synaptics_td4322/Kconfig"

config TOUCHSCREEN_MTK_NT36772
	bool "NVT for Mediatek package"
	default n
	help
	  Say Y here if you have NVT touch panel.

	  If unsure, say N.

	  To compile this driver as a module, choose M here: the
	  module will be called.

source "drivers/input/touchscreen/mediatek/NVT/Kconfig"

endif
```

## drivers/input/touchscreen/mediatek/NVT/Kconfig
```kconfig
#
# Touchscreen driver configuration
#
if TOUCHSCREEN_MTK_NT36772

choice
	default TOUCHSCREEN_NT36772_1080_1920
		prompt "Novatek NT36772 Panels"

config TOUCHSCREEN_NT36772_1080_1920
		bool "NT36772_1080_1920"
		depends on I2C
		help
			Say Y here if you have a Novatek NT36772 Panel
			to the host processor over I2C

			If unsure, say N.
endchoice

endif
```

## drivers/input/touchscreen/mediatek/ft8607/Kconfig
```kconfig
#
# Touchscreen driver configuration
#
if TOUCHSCREEN_MTK_FT8607

#config FT8607_FIRMWARE
#	string "FT8607 for Mediatek firmware"

config FOCAL_CHARGER_MODE
	bool "ft8607 charger mode"
	default n
	help
	Say Y here if you have ft8607 touch panel.

	If unsure, say N.

config TPD_ROTATE_90
	bool "ft5x0x for Mediatek package"
	default n
	help
	Say Y here if you have ft5x0x touch panel TPD_ROTATE_90.

	If unsure, say N.

	To compile this dirver as a module, choose M here: the
	module will be called.

config TPD_ROTATE_180
	bool "ft5x0x for Mediatek package"
	default n
	help
	Say Y here if you have ft5x0x touch panel TPD_ROTATE_180.

	If unsure, say N.

	To compile this dirver as a module, choose M here: the
	module will be called.

config TPD_ROTATE_270
	bool "ft5x0x for Mediatek package"
	default n
	help
	Say Y here if you have ft5x0x touch panel TPD_ROTATE_270.

	If unsure, say N.

	To compile this dirver as a module, choose M here: the
	module will be called.

config FT_AUTO_UPGRADE_SUPPORT
	bool "ft5x0x for Mediatek package"
	default y
	help
	Say Y here if you have ft5x0x touch panel FT_AUTO_UPGRADE_SUPPORT.

	If unsure, say N.

	To compile this dirver as a module, choose M here: the
	module will be called.

config TPD_HAVE_CALIBRATION
	bool "ft5x0x for Mediatek package"
	default n
	help
	Say Y here if you have ft5x0x touch panel TPD_HAVE_CALIBRATION.

	If unsure, say N.

	To compile this dirver as a module, choose M here: the
	module will be called.

config TPD_CUSTOM_CALIBRATION
	bool "ft5x0x for Mediatek package"
	default n
	help
	Say Y here if you have ft5x0x touch panel TPD_CUSTOM_CALIBRATION.

	If unsure, say N.

	To compile this dirver as a module, choose M here: the
	module will be called.
endif
```

## drivers/misc/diag/Kconfig
```kconfig
#
# Sony diag related
#

menuconfig SONY_DIAG
	bool "Support Sony diag solution"
	default y
	help
	  This option enables sony diag solution.

if SONY_DIAG

config SONY_DBGCONTROL
	bool "Support Sony dbgcontrol feature"
	default y
	help
	  This option enables sony dbgcontrol.We use dbgcontrol to
          trigger system crash on odm product.This feature can works
          on eng/userdebug/user varient.The wiki for this:
          https://wiki.sonyericsson.net/odm/Dbgcontrol

config POWERKEY_FORCECRASH
	tristate "Force a crash on powerkey long press"
	default n
	help
	  Say Y here if you want force crash functionality through power
	  key. Triggers panic if power key is hold for more than 30 secs.

endif
```

## drivers/misc/mediatek/accelerometer/bma255-new/Kconfig
```kconfig
config MTK_BMA255_NEW
       bool "MTK_BMA255_NEW for Mediatek package"
	default n
	help
	  It support different accelerometer sensor.
          If this option is set,
	  it will support
          MTK_BMA255_NEW Accelerometer.
```

## drivers/misc/mediatek/alsps/stk3x1x-new/Kconfig
```kconfig
config CONFIG_MTK_STK3X1X_NEW
	bool "stk3x1x for MediaTek package"
	default y
	help
	It support different type sensor
	in this platform. If this option
	is set, it will support ambient
	and light sensor CM36558.
```

## drivers/misc/mediatek/magnetometer/gmc303-new/Kconfig
```kconfig
config MTK_GMC303_NEW
        bool "MTK_GMC303_NEW for Mediatek package"
        default n
	help
	  It support different magnetometer sensor.
          If this option is set,
	  it will support
          GMC303 magnetometer.
```

## drivers/misc/mediatek/magnetometer/gmc306-new/Kconfig
```kconfig
config MTK_GMC306_NEW
        bool "MTK_GMC306_NEW for Mediatek package"
        default n
	help
	  It support different magnetometer sensor.
          If this option is set,
	  it will support
          GMC306 magnetometer.

config CUSTOM_KERNEL_SENSORHUB
        bool "MTK_GMC306 for Mediatek package SENSORHUB"
        default n
        help
        Say Y here if you have MTK_GMC306 touch panel CUSTOM_KERNEL_SENSORHUB.

        If unsure, say N.

        To compile this dirver as a module, choose M here: the
        module will be called.
```

## drivers/misc/mediatek/xhci/Kconfig
```kconfig
#
# Mediatek XHCI Driver
#

config USB_MTK_DUALMODE
	bool "MediaTek DUAL MODE support"
	default n
	depends on USB_XHCI_MTK
	---help---
	  Enable Mediatek USB Host OTG DUAL-ROLE SUPPORT
	  The USB Port can act device role or host role.
	  Say Y here if your system support usb otg DUAL_ROLE.
	  If unsure, say N.

config USB_MTK_IDDIG
	bool "MediaTek OTG IDDIG support"
	default n
	depends on USB_MTK_DUALMODE
	---help---
	  Enable Mediatek USB Host OTG detection mechanism
	  IDDIG - OTG cable attachment detection.
	  Say Y here if your system support OTG IDDIG detection.
	  If unsure, say N.

config MTK_TEST_XHCI
	tristate "MediaTek U3 TEST XHCI driver support"
	default n
	---help---
	  Enables support Mediatek U3 XHCI test driver
	  kernel framework.
	  Say Y if you would like to do verification program.
	  If unsure, say N.

config USB_MTK_OTG_SWITCH
	tristate "MediaTek OTG IDDIG Function Switch"
	default n
	depends on USB_MTK_IDDIG
	---help---
	  Enable Mediatek OTG function Switch mechanism.
	  The default OTG DUALROLE function is disabled.
	  User can switch to enable or disable by command.
	  Say Y here if your want to use mechanism.
	  If unsure, say N.

config TUSB320_TYPEC
	tristate "tusb320 typec connector"
	default y
	---help---
	  Say Y here to enable tusb320 Type C Connector support.

config WUSB3801Q_TYPEC
	tristate "wusb3801q typec connector"
	default y
	---help---
	  Say Y here to enable wusb3801q Type C Connector support.
```
